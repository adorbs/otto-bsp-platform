## sources/base/conf/local.conf.sample
```bitbake
MACHINE ??= 'otto-proto-v1'
DISTRO ?= 'poky'
PACKAGE_CLASSES ?= "package_rpm"
EXTRA_IMAGE_FEATURES ?= "debug-tweaks"
USER_CLASSES ?= "buildstats image-mklibs image-prelink"
PATCHRESOLVE = "noop"
BB_DISKMON_DIRS ??= "\
    STOPTASKS,${TMPDIR},1G,100K \
    STOPTASKS,${DL_DIR},1G,100K \
    STOPTASKS,${SSTATE_DIR},1G,100K \
    STOPTASKS,/tmp,100M,100K \
    ABORT,${TMPDIR},100M,1K \
    ABORT,${DL_DIR},100M,1K \
    ABORT,${SSTATE_DIR},100M,1K \
    ABORT,/tmp,10M,1K"
PACKAGECONFIG_append_pn-qemu-native = " sdl"
PACKAGECONFIG_append_pn-nativesdk-qemu = " sdl"
CONF_VERSION = "1"
DISABLE_SPLASH = "1"
ENABLE_I2C = "1"
ENABLE_SPI_BUS = "1"
ENABLE_UART = "1"
RPI_EXTRA_CONFIG = "framebuffer_width=320\n\
					framebuffer_height=240\n\
					dtoverlay=r61505w,rotate=270\n\
					dtoverlay=fe-pi-audio\n\
					hdmi_force_hotplug=1\n\
					hdmi_group=2\n\
					hdmi_mode=87\n\
					hdmi_cvt=320 240 60 1 0 0 0\n\
"
```
